## esp32s3-swift-test/sdkconfig.defaults
```kconfig
# Target configuration
CONFIG_IDF_TARGET_ESP32S3=y
CONFIG_IDF_TARGET="esp32s3"

# Performance optimizations
CONFIG_COMPILER_OPTIMIZATION_SIZE=y
CONFIG_COMPILER_OPTIMIZATION_ASSERTIONS_DISABLE=y

# Memory configuration
CONFIG_SPIRAM_USE_MALLOC=y
CONFIG_SPIRAM_MALLOC_ALWAYSINTERNAL=16384

# Linker configuration for Swift
CONFIG_LINKER_ORPHAN_HANDLING_PLACE=y

# Enable atomic operations support
CONFIG_COMPILER_WARN_WRITE_STRINGS=y

# Disable ROM functions to avoid conflicts with Swift code
CONFIG_NEWLIB_NANO_FORMAT=y
CONFIG_ESP_ROM_HAS_MBEDTLS_CRYPTO_LIB=n
CONFIG_ESP_ROM_HAS_UART_BUF_SWITCH=n
CONFIG_ESP_ROM_HAS_RETARGETABLE_LOCKING=n

# Force use of RAM-based string functions
CONFIG_NEWLIB_STDOUT_LINE_ENDING_CRLF=y
CONFIG_NEWLIB_STDIN_LINE_ENDING_CR=y
```
